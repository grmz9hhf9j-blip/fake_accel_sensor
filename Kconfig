## Kconfig
```kconfig
config SENSOR_XYZ
    bool "Fake XYZ accelerometer"
    depends on SENSOR

config SENSOR_XYZ_RATE_HZ
    int "Default sample rate"
    depends on SENSOR_XYZ
    default 100
    range 1 1600
```

## dts/bindings/sensor,xyz.yaml
```yaml
description: Fake three-axis accelerometer

compatible: "sensor,xyz"

include: base.yaml

properties:
  odr-hz:
    type: int
    default: 100
    description: |
      Output data rate in Hz, from 1 to 1600.
      When omitted, defaults to 100 Hz.
```
